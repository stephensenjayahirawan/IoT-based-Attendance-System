/*************************************************** 
  This is an example sketch for our optical Fingerprint sensor

  Adafruit invests time and resources providing this open source code, 
  please support Adafruit and open-source hardware by purchasing 
  products from Adafruit!

  Written by Limor Fried/Ladyada for Adafruit Industries.  
  BSD license, all text above must be included in any redistribution
 ****************************************************/


#include <Adafruit_Fingerprint.h>
#include <ESP8266WiFi.h>
#include <WiFiClient.h> 
#include <ESP8266HTTPClient.h>
#include <ArduinoJson.h>
 
const char* wifiName = "it@bkaunpar";
const char* wifiPass = "kantinqiu";
 
//Web Server address to read/write from 
const char *host = "http://stephen.parkboy.net/getFingerprint";
int getFingerprintIDez();

// pin #2 is IN from sensor (GREEN wire)
// pin #3 is OUT from arduino  (WHITE wire)
SoftwareSerial mySerial(4,5);


  String payload="";
   // Parse JSON object
Adafruit_Fingerprint finger = Adafruit_Fingerprint(&mySerial);
byte fingerprint1[] = {0xEF, 0x01, 0xFF, 0xFF, 0xFF, 0xFF, 0x02, 0x00, 0x82, 0x03, 0x01, 0x4F, 0x1C,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 0x0E, 0x4E};
byte fingerprint2[] = {0xEF, 0x01, 0xFF, 0xFF, 0xFF, 0xFF, 0x02, 0x00, 0x82, 0x03, 0x01, 0x46, 0x17,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 0x02, 0xDF};
byte fingerprint3[] = {0xEF, 0x01, 0xFF, 0xFF, 0xFF, 0xFF, 0x02, 0x00, 0x82, 0x03, 0x01, 0x53, 0x13,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 0x00, 0x8A};
void setup()         

{
  
  Serial.begin(9600);
  while(!Serial);
  Serial.println("Fingerprint template extractor");

  // set the data rate for the sensor serial port
  finger.begin(57600);
  WiFi.begin(wifiName, wifiPass);
 
  while (WiFi.status() != WL_CONNECTED) {
    delay(500);
    Serial.print(".");
  }
 
  Serial.println("");
  Serial.println("WiFi connected");
  Serial.println("IP address: ");
  Serial.println(WiFi.localIP()); 
  
  if (finger.verifyPassword()) {
    Serial.println("Found fingerprint sensor!");
  } else {
    Serial.println("Did not find fingerprint sensor :(");
    while (1);
  }
 
  Serial.print("Request Link:");
  Serial.println(host);
  HTTPClient http;
  http.begin(host);     //Specify request destination
  
  int httpCode = http.GET();            //Send the request
  payload = http.getString();    //Get the response payload from server
 
  Serial.print("Response Code:"); //200 is OK
  Serial.println(httpCode);   //Print HTTP return code
 
  Serial.print("Returned data from Server:");
//  Serial.println(payload);    //Print request response payload
  const size_t capacity = JSON_OBJECT_SIZE(3) + JSON_ARRAY_SIZE(2) + 60;
    DynamicJsonBuffer jsonBuffer(capacity);
  if(httpCode == 200)
  {
   JsonObject& root = jsonBuffer.parseObject(payload);
   
    if (!root.success()) {
      Serial.println(F("Parsing failed!"));
      return;
    }
  
    // Decode JSON/Extract values
    Serial.println(F("Response:"));
    Serial.println(root["FINGERPRINT"]["length"].as<int>());
    
    uint8_t id = 1;
    downloadFingerprintTemplate(id);
    Serial.println("------------------------------------");
    Serial.print("Attempting to load #"); Serial.println(id);
    int written = 0;
  //  mySerial.write(fingerprint,sizeof(fingerprint));
    
//    mySerial.write(fingerprint1,sizeof(fingerprint1)); 
    mySerial.flush();
    uint8_t p = finger.uploadTemplate();
      mySerial.flush();
      
    if (p == FINGERPRINT_OK) {
      Serial.println("Writing Template!");
      for(int i = 0; i < root["FINGERPRINT"]["length"].as<int>()-1; i++){
          byte a = byte(root["FINGERPRINT"]["template"][i].as<int>());
          mySerial.write(a); 
          yield();
      }
      mySerial.flush();
    } else if (p == FINGERPRINT_PACKETRECIEVEERR) {
      Serial.println("Communication error");
    } else if (p == FINGERPRINT_BADLOCATION) {
      Serial.println("Could not store in that location");
    } else if (p == FINGERPRINT_FLASHERR) {
      Serial.println("Error writing to flash");
    } else {
      Serial.println("Unknown error");
    }  
    p = finger.uploadTemplate2();
      mySerial.flush();
      
    if (p == FINGERPRINT_OK) {
      Serial.println("Writing Template!");
      for(int i = 0; i < root["FINGERPRINT"]["length"].as<int>()-1; i++){
          byte a = byte(root["FINGERPRINT"]["template"][i].as<int>());
          mySerial.write(a); 
          yield();
      }
    } else if (p == FINGERPRINT_PACKETRECIEVEERR) {
      Serial.println("Communication error");
    } else if (p == FINGERPRINT_BADLOCATION) {
      Serial.println("Could not store in that location");
    } else if (p == FINGERPRINT_FLASHERR) {
      Serial.println("Error writing to flash");
    } else {
      Serial.println("Unknown error");
    }  
     mySerial.flush();
    p = finger.storeModel(id);
     
    if (p == FINGERPRINT_OK) {
      Serial.println("Stored!");
    } else if (p == FINGERPRINT_PACKETRECIEVEERR) {
      Serial.println("Communication error");
    } else if (p == FINGERPRINT_BADLOCATION) {
      Serial.println("Could not store in that location");
    } else if (p == FINGERPRINT_FLASHERR) {
      Serial.println("Error writing to flash");
    } else {
      Serial.println("Unknown error");
    }  
//    p = finger.uploadTemplate();
//      mySerial.flush();
//    if (p == FINGERPRINT_OK) {
//      Serial.println("Writing Template!");
//      for(int i = 0; i < root["FINGERPRINT"]["panjang"].as<int>()-1; i++){
//          byte a = byte(root["FINGERPRINT"]["sampah"][i].as<int>());
//          mySerial.write(a); 
//          Serial.print(a);
//          yield();
//      }
//      
//    } else if (p == FINGERPRINT_PACKETRECIEVEERR) {
//      Serial.println("Communication error");
//    } else if (p == FINGERPRINT_BADLOCATION) {
//      Serial.println("Could not store in that location");
//    } else if (p == FINGERPRINT_FLASHERR) {
//      Serial.println("Error writing to flash");
//    } else {
//      Serial.println("Unknown error");
//    }  
//    p = finger.storeModel(id);
//      mySerial.flush();
//    if (p == FINGERPRINT_OK) {
//      Serial.println("Stored!");
//    } else if (p == FINGERPRINT_PACKETRECIEVEERR) {
//      Serial.println("Communication error");
//    } else if (p == FINGERPRINT_BADLOCATION) {
//      Serial.println("Could not store in that location");
//    } else if (p == FINGERPRINT_FLASHERR) {
//      Serial.println("Error writing to flash");
//    } else {
//      Serial.println("Unknown error");
//    }
id= 2;
      p = finger.storeModel2(id);
      Serial.println(id+1);
      mySerial.flush();
    if (p == FINGERPRINT_OK) {
      Serial.println("Stored!");
    } else if (p == FINGERPRINT_PACKETRECIEVEERR) {
      Serial.println("Communication error");
    } else if (p == FINGERPRINT_BADLOCATION) {
      Serial.println("Could not store in that location");
    } else if (p == FINGERPRINT_FLASHERR) {
      Serial.println("Error writing to flash");
    } else {
      Serial.println("Unknown error");
    }  
   
  Serial.println("\ndone.");
  finger.getTemplateCount();
  Serial.print("Sensor contains "); Serial.print(finger.templateCount); Serial.println(" templates");
  Serial.println("Waiting for valid finger...");
 
    Serial.println();
    
  http.end();
  }
  else
  {
    Serial.println("Error in response");
  }

  // Try to get the templates for fingers 1 through 10
}

uint8_t downloadFingerprintTemplate(uint8_t id)
{
  
}


void printHex(int num, int precision) {
    char tmp[16];
    char format[128];
 
    sprintf(format, "%%.%dX", precision);
 
    sprintf(tmp, format, num);
    Serial.print(tmp);
}

void loop()
{
  
  getFingerprintIDez();
  delay(50);
}

int getFingerprintIDez() {
   HTTPClient http;
   http.begin(host); 
   int code = http.GET();
   payload = http.getString();
   const size_t capacity = JSON_OBJECT_SIZE(3) + JSON_ARRAY_SIZE(2) + 60;
   DynamicJsonBuffer jsonBuffer(capacity);
   JsonObject& root = jsonBuffer.parseObject(payload);
   http.end();
  uint8_t p = finger.getImage();
  if (p != FINGERPRINT_OK)  return -1;

  p = finger.image2Tz();
  if (p != FINGERPRINT_OK)  return -1;

  p = finger.fingerFastSearch();
  if (p != FINGERPRINT_OK)  return -1;
  
  // found a match!
  Serial.print("Found ID #"); Serial.print(finger.fingerID); 
  Serial.print(" with confidence of "); Serial.println(finger.confidence);
  return finger.fingerID; 
}
